## devices/planet-geminipda/kernel/delta/Documentation/devicetree/bindings/gpio/awinic,aw9523b.yaml
```yaml
# SPDX-License-Identifier: GPL-2.0-only OR BSD-2-Clause
%YAML 1.2
---
$id: http://devicetree.org/schemas/gpio/awinic,aw9523b.yaml#
$schema: http://devicetree.org/meta-schemas/core.yaml#

title: AWINIC AW9523B 16-bit I2C GPIO expander

maintainers:
  - Gemini PDA Linux Project

description: |
  The AW9523B provides two 8-bit GPIO ports (P0 = GPIO 0-7, P1 = GPIO 8-15)
  with per-pin direction control, interrupt generation, and optional LED mode.
  On the Gemini PDA it is used as a keyboard matrix controller.

properties:
  compatible:
    const: awinic,aw9523b

  reg:
    maxItems: 1

  gpio-controller: true

  '#gpio-cells':
    const: 2

  interrupt-controller: true

  '#interrupt-cells':
    const: 2

  interrupts:
    maxItems: 1
    description: IRQ from the AW9523B INT pin (active-low, open-drain)

  reset-gpios:
    maxItems: 1
    description: GPIO connected to the AW9523B SHDN (active-low reset) pin

required:
  - compatible
  - reg
  - gpio-controller
  - '#gpio-cells'

additionalProperties: false

examples:
  - |
    #include <dt-bindings/gpio/gpio.h>
    #include <dt-bindings/interrupt-controller/irq.h>

    i2c {
      #address-cells = <1>;
      #size-cells = <0>;

      keyboard_gpio: gpio@58 {
        compatible = "awinic,aw9523b";
        reg = <0x58>;
        gpio-controller;
        #gpio-cells = <2>;
        interrupt-controller;
        #interrupt-cells = <2>;
        interrupts = <87 IRQ_TYPE_LEVEL_LOW>;
        reset-gpios = <&pio 58 GPIO_ACTIVE_LOW>;
      };
    };
```

## devices/planet-geminipda/kernel/delta/Documentation/devicetree/bindings/input/touchscreen/solomon,ssd2092.yaml
```yaml
# SPDX-License-Identifier: GPL-2.0-only OR BSD-2-Clause
%YAML 1.2
---
$id: http://devicetree.org/schemas/input/touchscreen/solomon,ssd2092.yaml#
$schema: http://devicetree.org/meta-schemas/core.yaml#

title: Solomon Systech SSD2092 I2C touchscreen controller

maintainers:
  - Gemini PDA Linux Project

description: |
  Capacitive touchscreen controller found on the Planet Gemini PDA
  (AUO 5.99" 1080x2160 panel). The interrupt line is polled via GPIO
  on platforms whose pinctrl lacks EINT support.

allOf:
  - $ref: touchscreen.yaml#

properties:
  compatible:
    const: solomon,ssd2092-touch

  reg:
    const: 0x53

  reset-gpios:
    maxItems: 1
    description: Active-low CTP_RST line

  irq-gpios:
    maxItems: 1
    description: Active-low data-ready/INT line, polled by the driver

required:
  - compatible
  - reg
  - reset-gpios
  - irq-gpios

unevaluatedProperties: false

examples:
  - |
    #include <dt-bindings/gpio/gpio.h>
    i2c {
        #address-cells = <1>;
        #size-cells = <0>;
        touchscreen@53 {
            compatible = "solomon,ssd2092-touch";
            reg = <0x53>;
            reset-gpios = <&pio 68 GPIO_ACTIVE_LOW>;
            irq-gpios = <&pio 85 GPIO_ACTIVE_LOW>;
            touchscreen-size-x = <1080>;
            touchscreen-size-y = <2160>;
            touchscreen-inverted-x;
            touchscreen-swapped-x-y;
        };
    };
```
